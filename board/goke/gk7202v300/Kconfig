## board/goke/gk7202v300/Kconfig
```kconfig
if TARGET_GK7202V300

config SYS_BOARD
	default "gk7202v300"

config SYS_VENDOR
	default "goke"

config SYS_SOC
	default "gk7202v300"

config SYS_CONFIG_NAME
	default "gk7202v300"

endif
```

## board/goke/gk7205v200/Kconfig
```kconfig
if TARGET_GK7205V200

config SYS_BOARD
	default "gk7205v200"

config SYS_VENDOR
	default "goke"

config SYS_SOC
	default "gk7205v200"

config SYS_CONFIG_NAME
	default "gk7205v200"

endif
```

## board/goke/gk7205v300/Kconfig
```kconfig
if TARGET_GK7205V300

config SYS_BOARD
	default "gk7205v300"

config SYS_VENDOR
	default "goke"

config SYS_SOC
	default "gk7205v300"

config SYS_CONFIG_NAME
	default "gk7205v300"

endif
```

## board/goke/gk7605v100/Kconfig
```kconfig
if TARGET_GK7605V100

config SYS_BOARD
	default "gk7605v100"

config SYS_VENDOR
	default "goke"

config SYS_SOC
	default "gk7605v100"

config SYS_CONFIG_NAME
	default "gk7605v100"

endif
```
